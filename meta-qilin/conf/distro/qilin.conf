## meta-qilin/conf/distro/qilin.conf
```bitbake
DISTRO = "qilin"
DISTRO_NAME = "QiLin (Fii QiLin Distro)"

VERSION_ID:qilin = "v0.00-00-qilin"

DISTRO_FEATURES:append = " systemd usrmerge"
DISTRO_FEATURES_BACKFILL_CONSIDERED:append = " sysvinit"
VIRTUAL-RUNTIME_init_manager ??= "systemd"
VIRTUAL-RUNTIME_initscripts ??= "systemd-compat-units"
VIRTUAL-RUNTIME_login_manager ??= "shadow-base"
VIRTUAL-RUNTIME_dev_manager ??= "systemd"
```

## meta-qilin/conf/layer.conf
```bitbake
# We have a conf and classes directory, add to BBPATH
BBPATH .= ":${LAYERDIR}"
DL_DIR ?= "${TOPDIR}/../downloads"

# We have recipes-* directories, add to BBFILES
BBFILES += "${LAYERDIR}/recipes-*/*/*.bb \
            ${LAYERDIR}/recipes-*/*/*.bbappend"

INITRAMFS_MAXSIZE = "524288"

BBFILE_COLLECTIONS += "meta-qilin"
BBFILE_PATTERN_meta-qilin = "^${LAYERDIR}/"
BBFILE_PRIORITY_meta-qilin = "10"

LAYERVERSION_meta-qilin = "1"
LAYERDEPENDS_meta-qilin = "core"
LAYERSERIES_COMPAT_meta-qilin = "scarthgap styhead"
```

## meta-qilin/conf/machine/qilin.conf
```bitbake
#@TYPE: Machine
#@NAME: QiLin x86-64 Machine
#@DESCRIPTION: Machine configuration for running x86-64 System

PREFERRED_PROVIDER_virtual/kernel ?= "linux-yocto"

#require conf/machine/include/x86/arch-x86.inc
require conf/machine/include/x86/qemuboot-x86.inc
require conf/machine/include/x86/tune-x86-64-v3.inc
require conf/machine/include/qemu.inc

DEFAULTTUNE = "core2-64"

UBOOT_MACHINE ?= "qemu-x86_64_defconfig"

TARGET_ARCH = "x86_64"
KERNEL_IMAGETYPE = "bzImage"

SERIAL_CONSOLES ?= "115200;ttyS0"

APPEND += "rootwait console=ttyS0,115200 console=tty0"

#WKS_FILE ?= "core-image-qilin.wks"
#do_image_wic[depends] += "syslinux:do_populate_sysroot syslinux-native:do_populate_sysroot mtools-native:do_populate_sysroot dosfstools-native:do_populate_sysroot"

IMAGE_FSTYPES = "cpio tar.bz2 ext4"

#For runqemu
QB_SYSTEM_NAME = "qilin-x86_64"
```
